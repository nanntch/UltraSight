#include "Arduino.h"
#include "pitches.h"
#include <PCM.h>

const unsigned char left[] PROGMEM = {
  129, 129, 128, 127, 127, 128, 129, 129, 129, 129, 128, 129,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 140,   
  };

const unsigned char right[] PROGMEM = {
  129, 128, 127, 129, 128, 127, 128, 127, 127, 128, 128, 127,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 176,   
  };

const unsigned char front[] PROGMEM = {
  126, 126, 126, 127, 127, 128, 128, 127, 127, 128, 128, 128,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 114, 
  };
  
int Tr_left = 8; //blue
int Ec_left = 9; // green
int Tr_right = 10; // yellow
int Ec_right = 3; // orange
int buzzer = 11 ;  
int vibration = 13;
int pir_motion = 6;
int mutePin = 2;

boolean off = false;
int muteState = 0;

void setup() {
  pinMode(Tr_left, OUTPUT);
  pinMode(Ec_left, INPUT);
  pinMode(Tr_right, OUTPUT);
  pinMode(Ec_right, INPUT);
  pinMode(buzzer, OUTPUT);
  pinMode(vibration, OUTPUT);
  digitalWrite(vibration, HIGH);
  pinMode(pir_motion, INPUT);
  pinMode(mutePin, INPUT);
  Serial.begin(9600);
}

void loop() {
  muteState = digitalRead(mutePin);

  if(muteState == HIGH) {
    if (off == true) {
      off = false;
    } else {
      off = true;
    }
  }
  
  if(off == false) {
    int Dis_left  = Distance(Tr_left, Ec_left);
    int Dis_right = Distance(Tr_right, Ec_right);
    Serial.print(Dis_left); Serial.println(" cm from Left"); 
    Serial.print(Dis_right); Serial.println(" cm from Right");
    
    //default
    if ((abs(Dis_left - Dis_right) <= 5)&&(Dis_left <= 120)) {
        digitalWrite(vibration, LOW);
        delay(500);
        digitalWrite(vibration, HIGH);
        startPlayback(front, sizeof(front));
        delay(500);
    } else if(Dis_left < Dis_right) {
      if(Dis_left <= 120){
        digitalWrite(vibration, LOW);
        delay(500);
        digitalWrite(vibration, HIGH);
        startPlayback(left, sizeof(left));
        delay(500);
      }
    } else if (Dis_right < Dis_left) {
      if(Dis_right <= 120) {
        digitalWrite(vibration, LOW);
        delay(500);
        digitalWrite(vibration, HIGH);
        startPlayback(right, sizeof(right));
        delay(500);
       }
    } else {
        digitalWrite(buzzer, LOW);
    }
  }
    //MUTE MODE
    else if (off == true) {
      Serial.println("MUTE MODE");
      int Dis_left  = Distance(Tr_left, Ec_left);
      int Dis_right = Distance(Tr_right, Ec_right);
      Serial.print(Dis_left); Serial.println(" cm from Left"); 
      Serial.print(Dis_right); Serial.println("cm from Right");
      if ((abs(Dis_left - Dis_right) <= 5)&&(Dis_left <= 120)) {
          digitalWrite(vibration, LOW);
          delay(700);
          digitalWrite(vibration, HIGH);
      } else if(Dis_left < Dis_right) { //warning left
        if(Dis_left <= 120){
          digitalWrite(vibration, LOW);
          delay(100);
          digitalWrite(vibration, LOW);
          delay(100);
          digitalWrite(vibration, HIGH);
//          startPlayback(left, sizeof(left));
//          delay(1000);
        }
      } else if (Dis_right < Dis_left) { //warning right
          if(Dis_right <= 120) {
            digitalWrite(vibration, LOW);
            delay(400);
            digitalWrite(vibration, HIGH);
          }
      } else {
          digitalWrite(buzzer, LOW);
      }
    }
      delay(700); //big delay 
}

 int Distance(int Trig, int Echo){
  digitalWrite(Trig, LOW);
  delayMicroseconds(5);
  digitalWrite(Trig, HIGH);
  delayMicroseconds(10);
  digitalWrite(Trig, LOW);

  int duration = pulseIn(Echo, HIGH);
  int result = (duration*0.034)/2 ;
  if(result < 350){
    return result;
  }else{
    return 350;
  }
}
